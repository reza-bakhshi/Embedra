ENTRY(Reset_Handler)
MEMORY {
  FLASH (rx) : ORIGIN = 0x08000000, LENGTH = @FLASH_KIB@K
}
SECTIONS {
  .isr_vector 0x08000000 : { KEEP(*(.isr_vector)) } > FLASH
  .text 0x08000100 : { *(.text*) *(.rodata*) } > FLASH
  /DISCARD/ : { *(.comment*) *(.note*) *(.ARM.attributes*) }
}
